## drivers/Kconfig
```kconfig
# Copyright (c) 2021 FnLink (hunan) Technologies CO., LIMITED.
# Licensed under the Apache License, Version 2.0 (the "License");
# you may not use this file except in compliance with the License.
# You may obtain a copy of the License at
#
#     http://www.apache.org/licenses/LICENSE-2.0
#
# Unless required by applicable law or agreed to in writing, software
# distributed under the License is distributed on an "AS IS" BASIS,
# WITHOUT WARRANTIES OR CONDITIONS OF ANY KIND, either express or implied.
# See the License for the specific language governing permissions and
# limitations under the License.

config BOARD_DISPLAY
    bool "display"

config DISPLAY_A064
    bool "a064"
    depends on BOARD_DISPLAY

config DISPLAY_ICNA3311
    bool "icna3311"
    depends on BOARD_DISPLAY

config DISPLAY_RM69330
    bool "rm69330"
    depends on BOARD_DISPLAY

config BOARD_TOUCH
    bool "touch"

config TOUCH_FTS
    bool "fts"
    depends on BOARD_TOUCH

config TOUCH_ZTW523
    bool "ztw523"
    depends on BOARD_TOUCH
```
